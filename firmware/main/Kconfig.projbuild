## firmware/main/Kconfig.projbuild
```kconfig
menu "Familybox"

config FB_WIFI_SSID
    string "WiFi SSID"
    default "myssid"
    help
        2.4 GHz only - the ESP32-S3 has no 5 GHz radio.

config FB_WIFI_PASSWORD
    string "WiFi password"
    default ""

config FB_RELAY_URL
    string "Relay base URL"
    default "http://192.168.1.10:8090"
    help
        No trailing slash. Use https:// once the Cloudflare Tunnel is up.

config FB_RELAY_TOKEN
    string "Relay bearer token"
    default "changeme"

config FB_POLL_SECONDS
    int "Seconds between inbox polls"
    default 20
    range 5 600

config FB_MAX_RECORD_SECONDS
    int "Maximum voice reply length"
    default 30
    range 5 120

endmenu
```

## firmware/sdkconfig.defaults
```kconfig
CONFIG_IDF_TARGET="esp32s3"
CONFIG_ESPTOOLPY_FLASHMODE_QIO=y
CONFIG_ESPTOOLPY_FLASHSIZE_16MB=y
CONFIG_PARTITION_TABLE_CUSTOM=y
CONFIG_PARTITION_TABLE_CUSTOM_FILENAME="partitions.csv"
CONFIG_COMPILER_OPTIMIZATION_PERF=y
CONFIG_ESP_DEFAULT_CPU_FREQ_MHZ_240=y
CONFIG_ESP32S3_DATA_CACHE_LINE_64B=y
CONFIG_FREERTOS_HZ=1000

# 8MB octal PSRAM. Every large buffer in this app lives here.
CONFIG_SPIRAM=y
CONFIG_SPIRAM_MODE_OCT=y
CONFIG_SPIRAM_SPEED_80M=y
CONFIG_SPIRAM_FETCH_INSTRUCTIONS=y
CONFIG_SPIRAM_RODATA=y

CONFIG_LV_FONT_MONTSERRAT_14=y
CONFIG_LV_FONT_MONTSERRAT_18=y
CONFIG_LV_FONT_MONTSERRAT_24=y
CONFIG_LV_FONT_MONTSERRAT_48=y
# CONFIG_LV_ATTRIBUTE_FAST_MEM_USE_IRAM is not set

# HTTPS to the relay via the public CA bundle (Cloudflare Tunnel / Tailscale).
CONFIG_MBEDTLS_CERTIFICATE_BUNDLE=y
CONFIG_MBEDTLS_CERTIFICATE_BUNDLE_DEFAULT_FULL=y
CONFIG_ESP_TLS_INSECURE=n

CONFIG_ESP_MAIN_TASK_STACK_SIZE=8192
CONFIG_ESP_SYSTEM_EVENT_TASK_STACK_SIZE=4096
CONFIG_HTTPD_MAX_REQ_HDR_LEN=1024
CONFIG_ESP_WIFI_STATIC_RX_BUFFER_NUM=6
CONFIG_ESP_WIFI_DYNAMIC_RX_BUFFER_NUM=16
CONFIG_SPIRAM_TRY_ALLOCATE_WIFI_LWIP=y
CONFIG_BSP_DISPLAY_LVGL_BUF_HEIGHT=20
# CONFIG_LV_USE_BUILTIN_MALLOC is not set
CONFIG_LV_USE_CLIB_MALLOC=y
```
